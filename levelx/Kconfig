## levelx/Kconfig
```kconfig
/*
 * @Author: Dyyt587 67887002+Dyyt587@users.noreply.github.com
 * @Date: 2024-02-16 11:29:49
 * @LastEditors: Dyyt587 67887002+Dyyt587@users.noreply.github.com
 * @LastEditTime: 2024-02-16 12:12:46
 * @FilePath: \levelx\levelx\Kconfig
 * @Description: 这是默认设置,请设置`customMade`, 打开koroFileHeader查看配置 进行设置: https://github.com/OBKoro1/koro1FileHeader/wiki/%E9%85%8D%E7%BD%AE
 */

# Kconfig file for package levelx
menuconfig PKG_USING_LEVELX
    bool "Threadx's wear-leveling component for rtthread."
    default n

if PKG_USING_LEVELX

    config PKG_LEVELX_PATH
        string
        default "/packages/system/levelx"

    menuconfig PKG_USING_LEVEL_NOR
        bool
        prompt "Enable levelx support for nor flash"
        default y
    if PKG_USING_LEVEL_NOR
        config PKG_USING_LEVEL_DEMO_MEM
            bool
            prompt "Enable levelx nor demo"
            default n
    endif

    menuconfig PKG_USING_LEVEL_NAND
        bool
        prompt "Enable levelx support for nand flash"
        default y
    choice
        prompt "Version"
        default PKG_USING_LEVELX_LATEST_VERSION
        help
            Select the package version
        config PKG_USING_LEVELX_LATEST_VERSION
            bool "latest"
    endchoice

    config PKG_LEVELX_VER
       string
       default "latest"    if PKG_USING_LEVELX_LATEST_VERSION

endif
```
